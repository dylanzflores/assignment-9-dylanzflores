## base_external/package/Config.in
```kconfig
menu "AESD External Packages"

source "$BR2_EXTERNAL_BASE_PATH/package/aesd-assignments/Config.in"
source "$BR2_EXTERNAL_BASE_PATH/package/aesd-char-driver/Config.in"
source "$BR2_EXTERNAL_BASE_PATH/package/ldd/Config.in"

endmenu
```
